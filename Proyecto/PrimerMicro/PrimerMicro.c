/*
 * PrimerMicro.c
 *
 * Created: 04/05/2017 04:59:22 p. m.
 * Author: adomingu
 * Made with love by: Agui, Pau, Isra.
 */

// Librerias Display Nokia
#include <mega328p.h>
#include <io.h>
#include <delay.h>
// Graphic Display functions
#include <glcd.h>

// Font used for displaying text
// on the graphic display
#include <font5x7.h>

// Librerias proyecto
#include <io.h>
#include <delay.h>
#include <display.h>
#include <stdio.h>
#include <stdint.h>
#include "FuncionesSerial.h"

// -- Imagen 1 -- //
flash unsigned char imagen1 [] = {
0x54, 0x00, 0x30, 0x00,
0x00, 0x00, 0x00, 0x00, 0x00, 0x00, 0x00, 0x00, 0x00, 0x00, 0x00, 0x00, 0x00, 0x00, 0x00, 0x00,
0x00, 0x3C, 0x3C, 0xEC, 0xFC, 0xB0, 0xF0, 0xB0, 0x30, 0x30, 0xB0, 0xB0, 0xB0, 0x30, 0xB0, 0xB0,
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0x00, 0x00, 0x00, 0x00, 0x00, 0x00, 0x00, 0x00, 
};

flash unsigned char imagen11 [] = {
0x54, 0x00, 0x30, 0x00,
0x00, 0x00, 0x00, 0x80, 0x80, 0x60, 0x60, 0x60, 0x80, 0x80, 0x00, 0x00, 0x00, 0x00, 0x00, 0x80,
0x60, 0x60, 0x80, 0x00, 0x00, 0xE0, 0xE0, 0xE0, 0x00, 0x00, 0x00, 0x00, 0x00, 0xE0, 0xE0, 0xE0,
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0x00, 0x00, 0x00, 0x00, 0x00, 0x00, 0x00, 0x00, 
};

flash unsigned char imagen2 [] = {
0x54, 0x00, 0x30, 0x00,
0x00, 0x00, 0x00, 0x00, 0x00, 0x00, 0x00, 0x00, 0x00, 0x00, 0x00, 0x00, 0x00, 0x00, 0x00, 0x00,
0x00, 0x00, 0x00, 0x00, 0x00, 0x00, 0x00, 0x00, 0x00, 0x00, 0x00, 0x00, 0x00, 0x00, 0x00, 0x00,
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0x00, 0x00, 0x00, 0x00, 0x00, 0x00, 0x00, 0x00, 
};

flash unsigned char imagen3 [] = {
0x54, 0x00, 0x30, 0x00,
0x00, 0x00, 0x00, 0x00, 0x00, 0x00, 0x00, 0x00, 0x00, 0x00, 0x00, 0x00, 0x00, 0x00, 0x00, 0x00,
0x00, 0x00, 0x00, 0x00, 0x00, 0x00, 0x00, 0x00, 0x00, 0x00, 0x00, 0x00, 0x00, 0x00, 0x00, 0x04,
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0x00, 0x00, 0x00, 0x00, 0x00, 0x00, 0x00, 0x00, 
};

flash unsigned char imagen4 [] = {
0x54, 0x00, 0x30, 0x00,
0x00, 0x00, 0x00, 0x00, 0x00, 0x00, 0x80, 0x80, 0x80, 0x80, 0xE0, 0xE0, 0xE0, 0xE0, 0x00, 0x00,
0x00, 0x00, 0x00, 0x00, 0x00, 0x80, 0x80, 0xE0, 0xE0, 0xE0, 0xE0, 0xE0, 0xE0, 0xE0, 0xE0, 0x80,
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0x00, 0x00, 0x00, 0x00, 0x00, 0x00, 0x00, 0x00, 
};

flash unsigned char imagen5 [] = {
0x54, 0x00, 0x30, 0x00,
0x00, 0x00, 0x00, 0x00, 0x00, 0x00, 0x00, 0x80, 0x80, 0x80, 0x80, 0x80, 0x80, 0x80, 0x80, 0x80,
0x80, 0x00, 0x00, 0x00, 0x00, 0x00, 0x00, 0x00, 0x00, 0x00, 0x00, 0x00, 0x00, 0x00, 0x80, 0x80,
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0x00, 0x00, 0x00, 0x00, 0x00, 0x00, 0x00, 0x00, 
};

// -- Inicilizacion Funcion ADC -- //
// ADC Voltage Reference: AVCC pin
#define ADC_VREF_TYPE ((0<<REFS1) | (1<<REFS0) | (0<<ADLAR))

// Read the AD conversion result
// Read Voltage=read_adc*(Vref/1024.0)
unsigned int read_adc(unsigned char adc_input)
{
    ADMUX=adc_input | ADC_VREF_TYPE;
    // Delay needed for the stabilization of the ADC input voltage
    delay_us(10);
    // Start the AD conversion
    ADCSRA|=(1<<ADSC);
    // Wait for the AD conversion to complete
    while ((ADCSRA & (1<<ADIF))==0);
    ADCSRA|=(1<<ADIF);
    return ADCW;
}

// -- Variables adicionales -- //
unsigned int voltDigitalX;
unsigned int voltDigitalY;
int dis1 = 0, dis2 = 0, dis3 = 0, dis4 = 0, i, juego1 = 0, play = 0, vidas = 4;
unsigned char dato;

void main(void)
{   
    // -- Configuracion Display LCD Nokia -- //
    // Declare your local variables here
    // Variable used to store graphic display
    // controller initialization data
    GLCDINIT_t glcd_init_data;

    // Specify the current font for displaying text
    glcd_init_data.font=font5x7;
    // No function is used for reading
    // image data from external memory
    glcd_init_data.readxmem=NULL;
    // No function is used for writing
    // image data to external memory
    glcd_init_data.writexmem=NULL;
    // Set the LCD temperature coefficient
    glcd_init_data.temp_coef=PCD8544_DEFAULT_TEMP_COEF;
    // Set the LCD bias
    glcd_init_data.bias=PCD8544_DEFAULT_BIAS;
    // Set the LCD contrast control voltage VLCD
    glcd_init_data.vlcd=PCD8544_DEFAULT_VLCD;

    glcd_init(&glcd_init_data);
    glcd_putimagef(0,0, imagen11, GLCD_PUTCOPY);
    delay_ms(1000);   
    glcd_putimagef(0,0, imagen1, GLCD_PUTCOPY);
    delay_ms(5000);

    // -- Ajustes de ADC -- //
    // ADC initialization
    // ADC Clock frequency: 125.000 kHz
    // ADC Voltage Reference: AVCC pin
    // ADC Auto Trigger Source: ADC Stopped
    // Digital input buffers on ADC0: Off, ADC1: Off, ADC2: On, ADC3: On
    // ADC4: On, ADC5: On
    DIDR0=(0<<ADC5D) | (0<<ADC4D) | (0<<ADC3D) | (0<<ADC2D) | (1<<ADC1D) | (1<<ADC0D);
    ADMUX=ADC_VREF_TYPE;
    ADCSRA=(1<<ADEN) | (0<<ADSC) | (0<<ADATE) | (0<<ADIF) | (0<<ADIE) | (0<<ADPS2) | (1<<ADPS1) | (1<<ADPS0);
    ADCSRB=(0<<ADTS2) | (0<<ADTS1) | (0<<ADTS0);

     // USART initialization
    // Communication Parameters: 8 Data, 1 Stop, No Parity
    // USART Receiver: On
    // USART Transmitter: On
    // USART0 Mode: Asynchronous
    // USART Baud Rate: 56000 (Double Speed Mode)
    UCSR0A=(0<<RXC0) | (0<<TXC0) | (0<<UDRE0) | (0<<FE0) | (0<<DOR0) | (0<<UPE0) | (1<<U2X0) | (0<<MPCM0);
    UCSR0B=(0<<RXCIE0) | (0<<TXCIE0) | (0<<UDRIE0) | (1<<RXEN0) | (1<<TXEN0) | (0<<UCSZ02) | (0<<RXB80) | (0<<TXB80);
    UCSR0C=(0<<UMSEL01) | (0<<UMSEL00) | (0<<UPM01) | (0<<UPM00) | (0<<USBS0) | (1<<UCSZ01) | (1<<UCSZ00) | (0<<UCPOL0);
    UBRR0H=0x00;
    UBRR0L=0x11;
    
    // Coonfiguracion CTC 8MHz
    CLKPR=0X80;
    CLKPR=0;

    // -- Definicion de Inputs digitales -- //
    PORTC.5 = 1;
    PORTC.4 = 1;
    PORTC.3 = 1;
    PORTC.2 = 1;

    // -- Definicion de Outputs  -- //
    DDRD.7 = 1;
    DDRD.6 = 1;
    DDRB.2 = 1;
    DDRB.0 = 1;
    DDRD.5 = 1;

    while (1)
    {
        // -- Operacion de LCD Nokia -- //
        if(juego1 == 0){
            glcd_putimagef(0,0, imagen11, GLCD_PUTCOPY);   
        }
        // -- lectrua eje x del joystick -- //
        voltDigitalX = read_adc(0);        


        // -- Lectrua eje y del joystick -- //
        voltDigitalY = read_adc(1);

        // -- Movimiento por joystick -- //
        if (voltDigitalX<300){
            UART_write_txt("I");
            UART_write_txt("\n\r");
        }
        else if(voltDigitalX>700){
            UART_write_txt("D");
            UART_write_txt("\n\r");
        }  
        
        if (voltDigitalY<300){
            UART_write_txt("a");
            UART_write_txt("\n\r");
        }
        else if(voltDigitalY>700){
            UART_write_txt("A");
            UART_write_txt("\n\r");
        }

        // -- Lectura Serial -- //
        if ((UCSR0A&0x80)!=0) //Instruccion que nos dice si hay un caracter listo
                              // para leerse (bandera ?receive complete?)
        {
            dato=UART_read();       //Lee caracter del Puerto serie
                                  // Codigo para procesar el caracter recibido
            if((dato >= '1') && (dato <= '4')){
                switch(dato){
                    case '1':
                        if (dis1 == 0){
                            UART_write_txt("LED1 encendido\n\r");
                            PORTB.0 = 1;
                            dis1 = 1;
                        }
                        else{
                            UART_write_txt("LED1 Apagado\n\r");
                            dis1 = 0;
                            PORTB.0 = 0;
                        }
                        printf("\n\r");
                        break;
                    case '2':
                        if (dis2 == 0){
                            UART_write_txt("LED2 encendido\n\r");
                            PORTB.2 = 1;
                            dis2 = 1;
                        }
                        else{
                            UART_write_txt("LED2 apagado\n\r");
                            dis2 = 0;
                            PORTB.2 = 0;
                        }
                        printf("\n\r");
                        break;
                    case '3':
                        if (dis3 == 0){
                            UART_write_txt("LED3 encendido\n\r");
                            PORTD.6 = 1;
                            dis3 = 1;
                        }
                        else{
                            UART_write_txt("LED3 apagado\n\r");
                            dis3 = 0;
                            PORTD.6 = 0;
                        }
                        printf("\n\r");
                        break;
                    case '4':
                        if (dis4 == 0){
                            UART_write_txt("LED4 encendido\n\r");
                            PORTD.7 = 1;
                            dis4 = 1;
                        }
                        else{
                            UART_write_txt("LED4 apagado\n\r");
                            dis4 = 0;
                            PORTD.7 = 0;
                        }
                        printf("\n\r");
                        break;
                }
            } 
            else if(dato == 'O'){
                juego1 = 0; 
                vidas = 4;
                PORTB.0 = 0;
                PORTB.2 = 0;
                PORTD.6 = 0;
                PORTD.7 = 0;
                printf("\n\r");
                for (i = 0; i < 3; i++)
                {
                    glcd_putimagef(0,0, imagen5, GLCD_PUTCOPY);   
                    delay_ms(5000);
                    glcd_clear();
                    delay_ms(5000);
                }          
            }
            if (dato == 'M'){
                PORTD.5 = 1;
                delay_ms(5000);
                PORTD.5 = 0;
                vidas--;
            }
            
            else{
                printf("\n\r");
            }  
        }      
        if(juego1 == 1){ 
            if (play == 1 && vidas == 4){
                glcd_putimagef(0,0, imagen4, GLCD_PUTCOPY);   
                PORTB.0 = 1;
                delay_ms(3000);
                PORTB.2 = 1;
                delay_ms(3000);
                PORTD.6 = 1;
                delay_ms(3000);
                PORTD.7 = 1;
                delay_ms(3000);
                play = 0;
            }
            glcd_putimagef(0,0, imagen2, GLCD_PUTCOPY);   
            // Sin animacion
            //delay_ms(3000);
            //glcd_putimagef(0,0, imagen3, GLCD_PUTCOPY);   
            //delay_ms(3000);
            switch (vidas){
            case 3:
                PORTD.7 = 0;
                break;
            case 2:
                PORTD.6 = 0;
                break;
            case 1:
                PORTB.2 = 0;
                break;
            case 0:
                PORTB.0 = 0;
                break;
            default:
                break;
            }
        }
        // -- Transmision Serial -- //
        if (PINC.5 == 0){
            UART_write_txt("Str\n\r");
            play = 1;
            juego1 = 1;
        }while (PINC.5 == 0);        
        if (PINC.4 == 0){
            UART_write_txt("Esc\n\r");
        }while (PINC.4 == 0); 
        if (PINC.3 == 0){
            UART_write_txt("Jmp\n\r");
        }while (PINC.3 == 0); 
        if (PINC.2 == 0){
            UART_write_txt("Sho\n\r");
        }while (PINC.2 == 0);
    }
}
